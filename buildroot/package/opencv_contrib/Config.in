## buildroot/package/opencv_contrib/Config.in
```kconfig
config BR2_PACKAGE_OPENCV_CONTRIB
        bool "opencv_contrib"
	depends on BR2_PACKAGE_TESSERACT_OCR
	help
          Contrib packages for OpenCV 3.3+

          https://github.com/opencv/opencv_contrib
```

## buildroot/package/python-pylibdmtx/Config.in
```kconfig
config BR2_PACKAGE_PYTHON_PYLIBDMTX
	bool "python-pylibdmtx"
	select BR2_PACKAGE_LIBDMTX
	help
	  Datamatrix 2D barcode decoding, python wrappers.
	  https://pypi.org/project/pylibdmtx/
```

## buildroot/package/python-pytorch/Config.in
```kconfig
config BR2_PACKAGE_PYTHON_PYTORCH
	bool "python-pytorch"
	help
      PyTorch deep neural network framework
	  https://github.com/pytorch/pytorch/
```

## buildroot/package/python-scipy/Config.in
```kconfig
config BR2_PACKAGE_PYTHON_SCIPY
	bool "python-scipy"
    depends on BR2_PACKAGE_CLAPACK
    depends on BR2_PACKAGE_PYTHON_NUMPY_ARCH_SUPPORTS
    select BR2_PACKAGE_PYTHON_NUMPY
    depends on BR2_TOOLCHAIN_BUILDROOT_FORTRAN
    
    help
	  Python scientific library.

	  https://github.com/scipy/scipy
```
